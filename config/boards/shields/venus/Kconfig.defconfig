## config/boards/shields/venus/Kconfig.defconfig
```kconfig
if SHIELD_VENUS_LEFT
config ZMK_KEYBOARD_NAME
    default "venus"
config ZMK_SPLIT_ROLE_CENTRAL
    default y
config ZMK_SPLIT_BLE_ROLE_CENTRAL
    default y
endif

if SHIELD_VENUS_LEFT || SHIELD_VENUS_RIGHT
config ZMK_SPLIT
    default y
endif
```

## config/boards/shields/venus/Kconfig.shield
```kconfig
config SHIELD_VENUS_LEFT
    def_bool $(shields_list_contains,venus_left)
config SHIELD_VENUS_RIGHT
    def_bool $(shields_list_contains,venus_right)
```
