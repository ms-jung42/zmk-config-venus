#include "venus.dtsi" // Notice that the main dtsi files are included in the overlay.

&kscan0 {
row-gpios
        = <&gpio0 2 (GPIO_ACTIVE_HIGH | GPIO_PULL_DOWN)> // Row A from the schematic file
        , <&gpio0 20 (GPIO_ACTIVE_HIGH | GPIO_PULL_DOWN)> // Row B from the schematic file
        , <&gpio1 15 (GPIO_ACTIVE_HIGH | GPIO_PULL_DOWN)> // Row C from the schematic file
        , <&gpio0 29 (GPIO_ACTIVE_HIGH | GPIO_PULL_DOWN)> // Row D from the schematic file
        , <&gpio0 22  (GPIO_ACTIVE_HIGH | GPIO_PULL_DOWN)> // Row E from the schematic file
        ;

col-gpios
        = <&gpio0 31 GPIO_ACTIVE_HIGH> // col1 in the schematic
        , <&gpio0 24 GPIO_ACTIVE_HIGH> // col2 in the schematic
        , <&gpio0 11 GPIO_ACTIVE_HIGH> // col3 in the schematic
        , <&gpio1 13 GPIO_ACTIVE_HIGH> // col4 in the schematic
        , <&gpio1 4 GPIO_ACTIVE_HIGH> // col5 in the schematic
        , <&gpio0 10 GPIO_ACTIVE_HIGH> // col6 in the schematic
        , <&gpio1 0 GPIO_ACTIVE_HIGH> // col6 in the schematic
        ;
};
